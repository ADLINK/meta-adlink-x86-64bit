## conf/layer.conf
```bitbake
# We have a conf and classes directory, add to BBPATH
BBPATH .= ":${LAYERDIR}"

# We have recipes-* directories, add to BBFILES
BBFILES += "${LAYERDIR}/recipes-*/*/*.bb \
            ${LAYERDIR}/recipes-*/*/*.bbappend"

BBFILE_COLLECTIONS += "meta-adlink-x86-64bit"
BBFILE_PATTERN_meta-adlink-x86-64bit := "^${LAYERDIR}/"

# Additional license directories.
#LICENSE_PATH += "${LAYERDIR}/custom-licenses"

LAYERDEPENDS_meta-adlink-x86-64bit = "intel adlink-demo"
LAYERRECOMMENDS_meta-adlink-x86-64bit = "dpdk intel-qat"

# This should only be incremented on significant changes that will
# cause compatibility issues with other layers
LAYERVERSION_meta-adlink-x86-64bit = "6"
LAYERSERIES_COMPAT_meta-adlink-x86-64bit = "zeus dunfell hardknott"
```
